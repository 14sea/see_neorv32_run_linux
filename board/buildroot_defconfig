## board/buildroot_defconfig
```kconfig
# Buildroot defconfig for NEORV32 RV32IMAC nommu Linux on AX301

# Architecture: RISC-V 32-bit
BR2_riscv=y
BR2_RISCV_32=y
BR2_riscv_custom=y
BR2_RISCV_ISA_RVM=y
BR2_RISCV_ISA_RVA=y
BR2_RISCV_ISA_RVC=y
BR2_RISCV_ABI_ILP32=y

# Toolchain: musl (smaller than glibc, suits embedded)
BR2_TOOLCHAIN_BUILDROOT=y
BR2_TOOLCHAIN_BUILDROOT_MUSL=y

# Kernel
BR2_LINUX_KERNEL=y
BR2_LINUX_KERNEL_CUSTOM_VERSION=y
BR2_LINUX_KERNEL_CUSTOM_VERSION_VALUE="6.6.83"
BR2_LINUX_KERNEL_USE_CUSTOM_CONFIG=y
BR2_LINUX_KERNEL_CUSTOM_CONFIG_FILE="$(BR2_EXTERNAL_NEORV32_PATH)/board/neorv32_ax301/linux_defconfig"
BR2_LINUX_KERNEL_DTS_SUPPORT=y
BR2_LINUX_KERNEL_CUSTOM_DTS_PATH="$(BR2_EXTERNAL_NEORV32_PATH)/board/neorv32_ax301/neorv32_ax301.dts"
BR2_LINUX_KERNEL_IMAGE=y

# Root filesystem: initramfs (cpio, embedded in kernel or separate)
BR2_TARGET_ROOTFS_CPIO=y
BR2_TARGET_ROOTFS_CPIO_GZIP=y
# CONFIG_BR2_TARGET_ROOTFS_TAR is not set

# System
BR2_TARGET_GENERIC_HOSTNAME="neorv32"
BR2_TARGET_GENERIC_ISSUE="NEORV32 nommu Linux"
BR2_SYSTEM_DEFAULT_PATH="/bin:/sbin:/usr/bin:/usr/sbin"
BR2_TARGET_GENERIC_GETTY=y
BR2_TARGET_GENERIC_GETTY_PORT="ttyNEO0"
BR2_TARGET_GENERIC_GETTY_BAUDRATE_115200=y

# Init: none (use our custom init or busybox init)
BR2_INIT_BUSYBOX=y

# BusyBox
BR2_PACKAGE_BUSYBOX=y

# Post-build script
BR2_ROOTFS_POST_BUILD_SCRIPT="$(BR2_EXTERNAL_NEORV32_PATH)/board/neorv32_ax301/post-build.sh"

# Minimize size
BR2_OPTIMIZE_S=y
BR2_STRIP_strip=y
```
